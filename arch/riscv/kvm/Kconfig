## arch/riscv/kvm/Kconfig
```kconfig
# SPDX-License-Identifier: GPL-2.0
#
# KVM configuration
#

source "virt/kvm/Kconfig"

menuconfig VIRTUALIZATION
	bool "Virtualization"
	help
	  Say Y here to get to see options for using your Linux host to run
	  other operating systems inside virtual machines (guests).
	  This option alone does not add any kernel code.

	  If you say N, all options in this submenu will be skipped and
	  disabled.

if VIRTUALIZATION

config KVM
	tristate "Kernel-based Virtual Machine (KVM) support (EXPERIMENTAL)"
	depends on RISCV_SBI && MMU
	select HAVE_KVM_EVENTFD
	select HAVE_KVM_IRQCHIP
	select HAVE_KVM_IRQFD
	select HAVE_KVM_IRQ_ROUTING
	select HAVE_KVM_MSI
	select HAVE_KVM_VCPU_ASYNC_IOCTL
	select KVM_GENERIC_DIRTYLOG_READ_PROTECT
	select KVM_GENERIC_HARDWARE_ENABLING
	select KVM_MMIO
	select KVM_XFER_TO_GUEST_WORK
	select MMU_NOTIFIER
	select PREEMPT_NOTIFIERS
	select SCHED_INFO
	select GUEST_PERF_EVENTS if PERF_EVENTS
	help
	  Support hosting virtualized guest machines.

	  If unsure, say N.

config KVM_DSM_IRQ_FORWARD
	bool "KVM DSM interrupt forwarding support"
	depends on KVM
	default n
	help
	  Provide support for GiantVM DSM interrupt forwarding.
	  When enabled on RISC-V, guest SBI IPI requests exit to
	  userspace via KVM_EXIT_DSM_SEND_IRQ so a distributed runtime
	  can route and reinject them on another QEMU/KVM instance.

config KVM_DSM
	bool
	depends on KVM

config KVM_DSM_TCP
	bool "KVM distributed shared memory over TCP"
	depends on KVM && INET
	select KVM_DSM
	default n
	help
	  Enable the TCP transport and Ivy page-coherence protocol used by
	  GiantVM distributed shared memory.  The initial RISC-V port does not
	  include the optional RDMA transport.

endif # VIRTUALIZATION
```
